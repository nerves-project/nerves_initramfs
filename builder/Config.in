## builder/Config.in
```kconfig
# Custom packages

source "$BR2_EXTERNAL_CUSTOM_PATH/package/nerves_initramfs/Config.in"
```

## builder/configs/nerves_initramfs_arm_defconfig
```kconfig
BR2_arm=y
BR2_STATIC_LIBS=y
BR2_GLOBAL_PATCH_DIR="${BR2_EXTERNAL_CUSTOM_PATH}/patches"
BR2_TOOLCHAIN_EXTERNAL=y
BR2_TOOLCHAIN_EXTERNAL_DOWNLOAD=y
BR2_TOOLCHAIN_EXTERNAL_URL="https://toolchains.bootlin.com/downloads/releases/toolchains/armv5-eabi/tarballs/armv5-eabi--musl--stable-2018.11-1.tar.bz2"
BR2_TOOLCHAIN_EXTERNAL_CUSTOM_PREFIX="$(ARCH)-buildroot-linux-musleabi"
BR2_TOOLCHAIN_EXTERNAL_GCC_7=y
BR2_TOOLCHAIN_EXTERNAL_HEADERS_4_1=y
BR2_TOOLCHAIN_EXTERNAL_CUSTOM_MUSL=y
BR2_TOOLCHAIN_EXTERNAL_CXX=y
BR2_INIT_NONE=y
# BR2_TARGET_ENABLE_ROOT_LOGIN is not set
BR2_SYSTEM_BIN_SH_NONE=y
# BR2_TARGET_GENERIC_GETTY is not set
BR2_ROOTFS_POST_BUILD_SCRIPT="${BR2_EXTERNAL_CUSTOM_PATH}/board/nerves_initramfs/post-build.sh"
# BR2_PACKAGE_BUSYBOX is not set
# BR2_PACKAGE_IFUPDOWN_SCRIPTS is not set
# BR2_TARGET_ROOTFS_TAR is not set
BR2_PACKAGE_NERVES_INITRAMFS=y
```

## builder/configs/nerves_initramfs_x86_64_defconfig
```kconfig
BR2_x86_64=y
BR2_STATIC_LIBS=y
BR2_GLOBAL_PATCH_DIR="${BR2_EXTERNAL_CUSTOM_PATH}/patches"
BR2_TOOLCHAIN_EXTERNAL=y
BR2_TOOLCHAIN_EXTERNAL_DOWNLOAD=y
BR2_TOOLCHAIN_EXTERNAL_URL="https://github.com/nerves-project/toolchains/releases/download/v1.2.0/nerves_toolchain_x86_64_unknown_linux_musl-linux_x86_64-1.2.0-4A08025.tar.xz"
BR2_TOOLCHAIN_EXTERNAL_CUSTOM_PREFIX="$(ARCH)-unknown-linux-musl"
BR2_TOOLCHAIN_EXTERNAL_GCC_8=y
BR2_TOOLCHAIN_EXTERNAL_HEADERS_4_4=y
BR2_TOOLCHAIN_EXTERNAL_CUSTOM_MUSL=y
BR2_TOOLCHAIN_EXTERNAL_CXX=y
BR2_INIT_NONE=y
# BR2_TARGET_ENABLE_ROOT_LOGIN is not set
BR2_SYSTEM_BIN_SH_NONE=y
# BR2_TARGET_GENERIC_GETTY is not set
BR2_ROOTFS_POST_BUILD_SCRIPT="${BR2_EXTERNAL_CUSTOM_PATH}/board/nerves_initramfs/post-build.sh"
# BR2_PACKAGE_BUSYBOX is not set
BR2_PACKAGE_FWUP=y
# BR2_PACKAGE_IFUPDOWN_SCRIPTS is not set
# BR2_TARGET_ROOTFS_TAR is not set
BR2_PACKAGE_NERVES_INITRAMFS=y
```

## builder/package/nerves_initramfs/Config.in
```kconfig
config BR2_PACKAGE_NERVES_INITRAMFS
	bool "nerves_initramfs"
	depends on BR2_INIT_NONE
	help
	  An initramfs project for Nerves.

	  https://github.com/nerves-project/nerves_initramfs

if BR2_PACKAGE_NERVES_INITRAMFS

config BR2_PACKAGE_NERVES_INITRAMFS_DEBUG
        bool "nerves_initramfs debug"
        help
          Enable debug output

endif
```

## builder/package/rootfs_mounter/Config.in
```kconfig
config BR2_PACKAGE_ROOTFS_MOUNTER
	bool "rootfs_mounter"
	depends on BR2_INIT_NONE
	help
	  Simple rootfs mounter.

	  https://github.com/fhunleth/rootfs_mounter
```
